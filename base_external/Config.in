## base_external/Config.in
```kconfig
source "$BR2_EXTERNAL_project_base_PATH/package/tic80/Config.in"
source "$BR2_EXTERNAL_project_base_PATH/package/fb-st7789v/Config.in"
```

## base_external/package/fb-st7789v/Config.in
```kconfig
config BR2_PACKAGE_FB_ST7789V
    bool "fb-st7789v"
    depends on BR2_LINUX_KERNEL
    help
      Adafruit ST7789V out-of-tree kernel module (fb_st7789v and
      st7789v_ada) for use with Adafruit PiTFT displays.
```

## base_external/package/tic80/Config.in
```kconfig
config BR2_PACKAGE_TIC80
    bool "tic80"
    depends on BR2_PACKAGE_SDL2
    depends on BR2_TOOLCHAIN_HAS_THREADS
    select BR2_PACKAGE_LIBCURL
    help
      TIC-80 fantasy computer.
      https://github.com/nesbox/TIC-80
```
